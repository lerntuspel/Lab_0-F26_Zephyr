## CMakeLists.txt
```
# SPDX-License-Identifier: Apache-2.0

cmake_minimum_required(VERSION 3.20.0)
find_package(Zephyr REQUIRED HINTS $ENV{ZEPHYR_BASE})
project(blinky)

target_sources(app PRIVATE src/main.c)

if(CONFIG_SUM_PRINT)
	target_sources(app PRIVATE sum_printk/sum_printk.c)
	target_include_directories(app PRIVATE sum_printk)
elseif(CONFIG_SUM_LOG)
	target_sources(app PRIVATE sum_log/sum_log.c)
	target_include_directories(app PRIVATE sum_log)
endif()
target_sources(app PRIVATE i2c/bme280.c)
target_include_directories(app PRIVATE i2c)
```

## Kconfig
```
menu "Sum function selection"

choice SUM_IMPLEMENTATION
	prompt "Sum function implementation"
	default SUM_PRINT

config SUM_PRINT
	bool "Print result with printk()"

config SUM_LOG
	bool "Print result with the Logger (includes hexdump)"
	select LOG

endchoice

endmenu

source "Kconfig.zephyr"
```

## prj.conf
```kconfig
CONFIG_GPIO=y
CONFIG_LOG=y
CONFIG_SUM_LOG=y
CONFIG_LOG_DEFAULT_LEVEL=3
# Sensor framework + I2C
CONFIG_SENSOR=y
CONFIG_I2C=y
CONFIG_BME280=y
```

## boards/nrf7002dk_nrf5340_cpuapp.overlay
```dts
/ {
	aliases {
		led5180 = &led1;    //custom LED alias
		button1 = &button0; //button toggle
	};
};
```

## src/main.c
```c
/*
 * Copyright (c) 2016 Intel Corporation
 *
 * SPDX-License-Identifier: Apache-2.0
 */

#include <stdio.h>
#include <zephyr/kernel.h>
#include <zephyr/drivers/gpio.h>
#include "bme280.h"

#ifdef CONFIG_SUM_PRINT
	#include "sum_printk.h"
#elif defined(CONFIG_SUM_LOG)
	#include "sum_log.h"
#endif

/* 1000 msec = 1 sec */
#define SLEEP_TIME_MS   2000
#define POLL_MS 50

/* The devicetree node identifier for the "led0" alias. */
#define LED1_NODE DT_ALIAS(led5180)
#define BUTTON1_NODE DT_ALIAS(button1)
/*
 * A build error on this line means your board is unsupported.
 * See the sample documentation for information on how to fix this.
 */
static const struct gpio_dt_spec led = GPIO_DT_SPEC_GET(LED1_NODE, gpios);
static const struct gpio_dt_spec button = GPIO_DT_SPEC_GET(BUTTON1_NODE, gpios);

int main(void)
{
	int ret;
	int last_state = 0;

	if (!gpio_is_ready_dt(&led) || !gpio_is_ready_dt(&button)) {
		return 0;
	}
	
	ret = gpio_pin_configure_dt(&led, GPIO_OUTPUT_INACTIVE);
	if (ret < 0) {
		return 0;
	}

	ret = gpio_pin_configure_dt(&button, GPIO_INPUT);
	if (ret < 0) {
		return 0;
	}

	if (bme280_init() < 0) {
		return 0;
	}
	int temp;

	while (1) {
		int state = gpio_pin_get_dt(&button);

		if (state < 0) {
			k_msleep(POLL_MS);
			continue;
		}

		if (state && !last_state) {
			gpio_pin_toggle_dt(&led);
			#ifdef CONFIG_SUM_PRINT
				int total = sum_printk(3, 4);
				if (bme280_read_temperature(&temp) == 0) {
					printk("Temperature: %d.%02d C\n", temp / 100, temp % 100);
				}
			#elif defined(CONFIG_SUM_LOG)
				int total = sum_log(3, 4);
				bme280_log_temperature();
			#endif

			
		}

		last_state = state;
		k_msleep(POLL_MS);
	}
	return 0;
}
```
